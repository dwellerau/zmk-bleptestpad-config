#include <physical_layouts.dtsi>

/ {
    bleptestpad_layout: bleptestpad_layout {
        compatible = "zmk,physical-layout";
        display-name = "Default";

        keys  //                     w   h    x    y     rot    rx    ry
            = <&key_physical_attrs 100 100    0    0       0     0     0>
            ;
    };
};
