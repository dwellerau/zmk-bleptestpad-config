#include <input/processors.dtsi>
#include <behaviors.dtsi>
#include <dt-bindings/zmk/bt.h>
#include <dt-bindings/zmk/pointing.h>
#include <dt-bindings/zmk/input_transform.h>

#define DEFAULT 0

&trackball_listener {
    /*
    scroller {
        layers = <SCRL>;
        #input-processors = <&zip_xy_transform INPUT_TRANSFORM_Y_INVERT>, <&zip_xy_scaler 1 90>, <&zip_xy_to_scroll_mapper>;
        input-processors = <&zip_xy_scaler 1 30>, <&zip_x_scaler 0 1>, <&zip_xy_to_scroll_mapper>;
    };
    */
};

/ {

    keymap {
        compatible = "zmk,keymap";

        base_layer {
            bindings = <&mkp LCLK>;
        };

    };
};